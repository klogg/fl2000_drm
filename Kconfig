## Kconfig
```kconfig
# SPDX-License-Identifier: GPL-2.0
config DRM_FL2000
	tristate "Fresco Logic FL2000 USB display adapters"
	depends on DRM && USB && I2C && MMU
	select DRM_KMS_HELPER
	select DRM_GEM_SHMEM_HELPER
	select DRM_BRIDGE
	select DRM_DISPLAY_HELPER
	select DRM_BRIDGE_CONNECTOR
	select REGMAP
	select IRQ_DOMAIN
	help
	  DRM/KMS and I2C transport support for Fresco Logic FL2000 USB
	  display adapters with automatic native VGA or external HDMI output
	  selection. Native VGA needs no bridge configuration. Configure an
	  external HDMI bridge independently; FL2000 does not identify or
	  instantiate that bridge.

	  If built as a module, this is called fl2000.

choice
	prompt "FL2000 frame preparation backend"
	depends on DRM_FL2000
	default DRM_FL2000_FRAME_SSSE3 if X86_64 && ARCH_HAS_KERNEL_FPU_SUPPORT
	default DRM_FL2000_FRAME_GENERIC
	help
	  Select the optional architecture-specific frame converter. Each
	  accelerated backend retains the portable implementation as a
	  runtime fallback when the processor lacks the required features.

config DRM_FL2000_FRAME_GENERIC
	bool "Portable scalar implementation"

config DRM_FL2000_FRAME_SSSE3
	bool "x86-64 SSSE3 conversion"
	depends on X86_64 && ARCH_HAS_KERNEL_FPU_SUPPORT

config DRM_FL2000_FRAME_BMI2
	bool "x86-64 BMI2 conversion"
	depends on X86_64

endchoice

config DRM_FL2000_IT66121
	tristate "IT6610/21/22 bridge with optional FL2000 transport"
	depends on DRM && I2C
	depends on DRM_ITE_IT66121 = n
	select REGMAP_I2C
	select DRM_KMS_HELPER
	select DRM_DISPLAY_HELPER
	select SND_SOC_HDMI_CODEC if SND_SOC
	help
	  IT6610/21/22 bridge with firmware-described board support and
	  optional FL2000 transport adaptations. Instantiate FL2000 clients
	  through userspace enumeration. This module shares the
	  standard IT66121 module name and cannot be enabled alongside it.

	  If built as a module, this is called it66121.
```
